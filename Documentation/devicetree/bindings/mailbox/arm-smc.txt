## drivers/gpu/drm/xen/Kconfig
```kconfig
config DRM_XEN
	bool "DRM Support for Xen guest OS"
	depends on XEN
	help
	  Choose this option if you want to enable DRM support
	  for Xen.

choice
	prompt "Xen DRM drivers selection"
	depends on DRM_XEN

config DRM_XEN_FRONTEND
	tristate "Para-virtualized frontend driver for Xen guest OS"
	depends on DRM_XEN
	depends on DRM
	select DRM_KMS_HELPER
	select VIDEOMODE_HELPERS
	select XEN_XENBUS_FRONTEND
	help
	  Choose this option if you want to enable a para-virtualized
	  frontend DRM/KMS driver for Xen guest OSes.

config DRM_XEN_ZCOPY
	tristate "Zero copy helper DRM driver for Xen"
	depends on DRM_XEN
	depends on DRM
	select DRM_KMS_HELPER
	help
	  Choose this option if you want to enable a zero copy
	  helper DRM driver for Xen. This is implemented via mapping
	  of foreign display buffer pages into current domain and
	  exporting a dumb via PRIME interface. This allows
	  driver domains to use buffers of unpriveledged guests without
	  additional memory copying.

config DRM_XEN_ZCOPY_CMA
	bool "Use CMA to allocate buffers"
	depends on DRM_XEN_ZCOPY
	help
	  Use CMA to allocate display buffers.

endchoice
```

## drivers/media/xen/Kconfig
```kconfig
config MEDIA_XEN_FRONTEND
	tristate "Xen para-virtualized camera frontend driver"
	depends on XEN && MEDIA_SUPPORT && VIDEO_V4L2
	select XEN_XENBUS_FRONTEND
	select VIDEOBUF2_DMA_SG
	select XEN_FRONT_PGDIR_SHBUF
	help
	  Choose this option if you want to enable a para-virtualized
	  frontend camera driver for Xen guest OSes.
```

## drivers/misc/cldatadrv/Kconfig
```kconfig
# SPDX-License-Identifier: GPL-2.0-only
#
# Cluster taurus device configuration
#
# This driver provides support for the
# Direct Communication between user application and Cr7-Cluster.
#
config CLUSTER_DATA_DRV
	tristate "Support the taurus protocol to communicate with domd applications"
	depends on ARM || ARM64
	depends on ARCH_RENESAS || COMPILE_TEST
	select RCAR_MFIS
	select RPMSG
	help
		Choose this option if you have an R-Car chipset and want to setup
		the communication between IC and domd applications.
```

## drivers/pci/controller/ucie-rcar/Kconfig
```kconfig
# SPDX-License-Identifier: GPL-2.0

menu "Renesas UCIe Support"
	depends on PCI

config UCIE_RCAR_HOST
	tristate "Renesas R-Car UCIe Host mode"
	depends on ARCH_RENESAS || COMPILE_TEST
	depends on PCI_MSI
	help
	  Say Y here if you want UCIe controller support on R-Car Gen5 SoCs.
	  This controller can work either as EP or RC. In order to enable
          host-specific features UCIE_RCAR_HOST must be selected and in
          order to enable device-specific features UCIE_RCAR_EP must be
          selected.

config UCIE_RCAR_EP
	tristate "Renesas R-Car UCIe Endpoint mode"
	depends on ARCH_RENESAS || COMPILE_TEST
	depends on PCI_MSI
	help
	  Say Y here if you want UCIe controller support on R-Car Gen5 SoCs.
	  This controller can work either as EP or RC. In order to enable
          host-specific features UCIE_RCAR_HOST must be selected and in
          order to enable device-specific features UCIE_RCAR_EP must be
          selected.

endmenu
```

## drivers/staging/android/Kconfig
```kconfig
menu "Android"

if ANDROID

config ASHMEM
	bool "Enable the Anonymous Shared Memory Subsystem"
	default n
	depends on SHMEM
	---help---
	  The ashmem subsystem is a new shared memory allocator, similar to
	  POSIX SHM but with different behavior and sporting a simpler
	  file-based API.

	  It is, in theory, a good memory allocator for low-memory devices,
	  because it can discard shared memory units when under memory pressure.

config ANDROID_VSOC
	tristate "Android Virtual SoC support"
	default n
	depends on PCI_MSI
	---help---
	  This option adds support for the Virtual SoC driver needed to boot
	  a 'cuttlefish' Android image inside QEmu. The driver interacts with
	  a QEmu ivshmem device. If built as a module, it will be called vsoc.

source "drivers/staging/android/ion/Kconfig"

source "drivers/staging/android/fiq_debugger/Kconfig"

config BOOTLOADER_CONTROL
	tristate "Bootloader Control Block module"
	default n
	help
	  This driver installs a reboot hook, such that if reboot() is invoked
	  with a string argument NNN, "bootonce-NNN" is copied to the command
	  field in the Bootloader Control Block on the /misc partition, to be
	  read by the bootloader. If the string matches one of the boot labels
	  defined in its configuration, it will boot once into that label. The
	  device and partition number are specified on the kernel command line.

endif # if ANDROID

endmenu
```

## sound/xen/Kconfig
```kconfig
# ALSA Xen drivers

config SND_XEN_FRONTEND
	tristate "Xen para-virtualized sound frontend driver"
	depends on XEN && SND_PCM
	select XEN_XENBUS_FRONTEND
	default n
	help
	  Choose this option if you want to enable a para-virtualized
	  frontend sound driver for Xen guest OSes.
```
